## conf/layer.conf
```bitbake
# We have a conf and classes directory, add to BBPATH
BBPATH .= ":${LAYERDIR}"

# We have recipes-* directories, add to BBFILES
BBFILES += "${LAYERDIR}/recipes-*/*/*.bb \
            ${LAYERDIR}/recipes-*/*/*.bbappend"

BBFILE_COLLECTIONS += "meta-kaonic"
BBFILE_PATTERN_meta-kaonic = "^${LAYERDIR}/"
BBFILE_PRIORITY_meta-kaonic = "6"

LAYERDEPENDS_meta-kaonic = "core"
LAYERSERIES_COMPAT_meta-kaonic = "mickledore"
```
